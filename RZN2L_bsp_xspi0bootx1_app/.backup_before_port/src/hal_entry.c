#include "hal_data.h"
#include "bsp_api.h"

FSP_CPP_HEADER
void R_BSP_WarmStart(bsp_warm_start_event_t event) BSP_PLACE_IN_SECTION(".warm_start");
FSP_CPP_FOOTER

#if defined(__ICCARM__)
#pragma section="USER_DATA_ZBLOCK"
#endif

extern bsp_leds_t g_bsp_leds;
extern void bsp_copy_multibyte(uintptr_t * src, uintptr_t * dst, uintptr_t bytesize);
extern void bsp_bss_init_multibyte(uintptr_t * src, uintptr_t bytesize);

/*******************************************************************************************************************//**
 * main() is generated by the FSP Configuration editor and is used to generate threads if an RTOS is used.  This function
 * is called by main() when no RTOS is used.
 **********************************************************************************************************************/
void hal_entry(void)
{
    /* Define the units to be used with the software delay function */
    const bsp_delay_units_t bsp_delay_units = BSP_DELAY_UNITS_MILLISECONDS;

    /* Set the blink frequency (must be <= bsp_delay_units */
    const uint32_t freq_in_hz = 2;

    /* Calculate the delay in terms of bsp_delay_units */
    const uint32_t delay = bsp_delay_units / freq_in_hz;

    /* LED type structure */
    bsp_leds_t leds = g_bsp_leds;

    /* If this board has no LEDs then trap here */
    if (0 == leds.led_count)
    {
        while (1)
        {
            ;                          // There are no LEDs on this board
        }
    }

    /* GIC settings for CPUINT0. */
    R_BSP_IrqCfgEnable(VECTOR_NUMBER_INTCPU0, 1, NULL);

    /* Enable interrupt. */
    __enable_irq();

    while (1)
    {
        /* Generate INTCPU0. */
        R_ICU_NS->NS_SWINT = 0x00000001U;

        /* Delay */
        R_BSP_SoftwareDelay(delay, bsp_delay_units);
    }
}

/*******************************************************************************************************************//**
 * This function is called at various points during the startup process.  This implementation uses the event that is
 * called right before main() to set up the pins.
 *
 * @param[in]  event    Where at in the start up process the code is currently at
 **********************************************************************************************************************/
void R_BSP_WarmStart (bsp_warm_start_event_t event)
{
    if (BSP_WARM_START_RESET == event)
    {
    	/* Pre clock initialization */
    }
    if (BSP_WARM_START_POST_CLOCK == event)
    {
#if defined(__ICCARM__)
    	volatile uintptr_t * src;
        uintptr_t   size;

        /* Clear application bss block. */
        src  = (uintptr_t *) __section_begin("USER_DATA_ZBLOCK");
        size = (uintptr_t) __section_end("USER_DATA_ZBLOCK") - (uintptr_t) __section_begin("USER_DATA_ZBLOCK");
        bsp_bss_init_multibyte((uintptr_t *)src, size);
#elif defined(__GNUC__)
        volatile uintptr_t * src;
        uintptr_t   size;
        extern void * __app_bss_start__;
        extern void * __app_bss_end__;

        /* Clear application bss block. */
        src  = (uintptr_t *) &__app_bss_start__;
        size = (uintptr_t) &__app_bss_end__ - (uintptr_t) &__app_bss_start__;
        bsp_bss_init_multibyte((uintptr_t *)src, size);
#endif
    }
    if (BSP_WARM_START_POST_C == event)
    {
        /* C runtime environment and system clocks are setup. */

#if BSP_FEATURE_DDR_SUPPORTED
  #if (1 == BSP_CFG_DDR_INIT_ENABLE)

       /* Initialize the DDR settings. */
       bsp_ddr_init();
 #endif
#endif

        if (NULL != g_bsp_pin_cfg.p_extend)
        {
            /* Configure pins. */
            R_IOPORT_Open(&IOPORT_CFG_CTRL, &IOPORT_CFG_NAME);
        }
    }
}

void intcpu0_handler(void) {

        /* LED type structure */
        bsp_leds_t leds = g_bsp_leds;

        /* This code uses BSP IO functions to show how it is used.*/
        R_BSP_PinAccessEnable();

        /* Update board LEDs */
        for (uint32_t i = 0; i < leds.led_count; i++)
        {
            /* Get pin to toggle */
            uint32_t pin = *leds.p_leds[i];

            /* Write to this pin */
            R_BSP_PinToggle(BSP_IO_REGION_SAFE, (bsp_io_port_pin_t) pin);
        }

        /* Protect PFS registers */
        R_BSP_PinAccessDisable();
}
